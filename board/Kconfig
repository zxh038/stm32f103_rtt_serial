## board/Kconfig
```kconfig
menu "Hardware Drivers Config"

config SOC_STM32F103VE
    bool
    select SOC_SERIES_STM32F1
    select RT_USING_COMPONENTS_INIT
    select RT_USING_USER_MAIN
    default y

menu "Onboard Peripheral Drivers"

    config BSP_USING_KEY
        bool "Enable onboard keys"
        default n
        select RT_USING_PIN
        select RT_USING_TIMER_SOFT
        select PKG_USING_FLEXIBLE_BUTTON

    config BSP_USING_SPI_FLASH
        bool "Enable SPI FLASH (W25Q64 spi1)"
        select BSP_USING_SPI
        select BSP_USING_SPI1
        select RT_USING_SFUD
        select RT_SFUD_USING_SFDP
        default n
endmenu

menu "On-chip Peripheral Drivers"

    config BSP_USING_GPIO
        bool "Enable GPIO"
        select RT_USING_PIN
        default y

    menuconfig BSP_USING_SPI
        bool "Enable SPI BUS"
        default n
        select RT_USING_SPI
        if BSP_USING_SPI
            config BSP_USING_SPI1
                bool "Enable SPI1 BUS"
                default n

            config BSP_SPI1_TX_USING_DMA
                bool "Enable SPI1 TX DMA"
                depends on BSP_USING_SPI1
                default n
                
            config BSP_SPI1_RX_USING_DMA
                bool "Enable SPI1 RX DMA"
                depends on BSP_USING_SPI1
                select BSP_SPI1_TX_USING_DMA
                default n

            config BSP_USING_SPI2
                bool "Enable SPI2 BUS"
                default n  
                
            config BSP_SPI2_TX_USING_DMA
                bool "Enable SPI2 TX DMA"
                depends on BSP_USING_SPI2
                default n
                
            config BSP_SPI2_RX_USING_DMA
                bool "Enable SPI2 RX DMA"
                depends on BSP_USING_SPI2
                select BSP_SPI2_TX_USING_DMA
                default n
                
            config BSP_USING_SPI3
                bool "Enable SPI3 BUS"
                default n        

            config BSP_SPI3_TX_USING_DMA
                bool "Enable SPI3 TX DMA"
                depends on BSP_USING_SPI3
                default n
                
            config BSP_SPI3_RX_USING_DMA
                bool "Enable SPI3 RX DMA"
                depends on BSP_USING_SPI3
                select BSP_SPI3_TX_USING_DMA
                default n  
        endif

    menuconfig BSP_USING_UART
        bool "Enable UART"
        default y
        select RT_USING_SERIAL
        if BSP_USING_UART
            menuconfig BSP_USING_UART1
                bool "Enable UART1 (Debugger)"
                default y
                if BSP_USING_UART1 #控制台(接收中断 + 发送轮询)
                    config BSP_UART1_RX_USING_DMA
                        bool "Enable UART1 RX DMA"
                        default n
                        depends on BSP_USING_UART1 && RT_SERIAL_USING_DMA

                    config BSP_UART1_TX_USING_DMA
                        bool "Enable UART1 TX DMA"
                        default n
                        depends on BSP_USING_UART1 && RT_SERIAL_USING_DMA

                    config BSP_UART1_RX_BUFSIZE
                        int "Set UART1 RX buffer size"
                        range 64 65535
                        default 512
                        depends on RT_USING_SERIAL_V2

                    config BSP_UART1_TX_BUFSIZE
                        int "Set UART1 TX buffer size"
                        range 0 65535
                        default 0
                        depends on RT_USING_SERIAL_V2
                endif

            menuconfig BSP_USING_UART2
                bool "Enable UART2"
                default y
                if BSP_USING_UART2 #通信串口(接收DMA + 发送DMA)
                    config BSP_UART2_RX_USING_DMA
                        bool "Enable UART2 RX DMA"
                        default y
                        depends on BSP_USING_UART2 && RT_SERIAL_USING_DMA

                    config BSP_UART2_TX_USING_DMA
                        bool "Enable UART2 TX DMA"
                        default y
                        depends on BSP_USING_UART2 && RT_SERIAL_USING_DMA

                    config BSP_UART2_RX_BUFSIZE
                        int "Set UART2 RX buffer size"
                        range 64 65535
                        default 2048
                        depends on RT_USING_SERIAL_V2

                    config BSP_UART2_TX_BUFSIZE
                        int "Set UART2 TX buffer size"
                        range 0 65535
                        default 2048
                        depends on RT_USING_SERIAL_V2
                endif
        endif

    source "libraries/HAL_Drivers/Kconfig"
       
endmenu

menu "Board extended module Drivers"

endmenu

endmenu
```
